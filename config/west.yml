## config/west.yml
```yaml
manifest:
  defaults:
    revision: v0.3
  remotes:
    - name: zmkfirmware
      url-base: https://github.com/zmkfirmware
    - name: beekeeb
      url-base: https://github.com/beekeeb
    - name: caksoylar
      url-base: https://github.com/caksoylar
  projects:
    - name: zmk
      remote: zmkfirmware
      revision: 5138c6fb14783b756c5a3e61581625c700f3555b
      import: app/west.yml
    - name: zmk-keyboard-toucan2
      remote: beekeeb
      revision: 6882c95bec5be89988e90feb621f78a7511e9ed7
      path: modules/zmk-keyboard-toucan2
    - name: zmk_driver_azoteq
      remote: beekeeb
      revision: c329f309b7481e5723603550b15f48e24d0c8a6a
    - name: zmk-input-zoom
      remote: beekeeb
      revision: 91bbe0c0e02145da50c9df798489479d28be1804
    - name: zmk-rgbled-widget
      remote: caksoylar
      revision: v0.3
  self:
    path: config
```
